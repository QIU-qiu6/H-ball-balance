#include "oled.h"
#include "stm32f10x.h"
#include <string.h>

#define OLED_ADDR_WRITE  0x78u
#define OLED_SCL_PIN     GPIO_Pin_6
#define OLED_SDA_PIN     GPIO_Pin_7

static u8 g_oled_buffer[1024];

/* Fixed 16x16 glyphs used by the H-task state screen. Row-major, MSB first. */
static const u8 g_zh_glyphs[31][32] = {
{0x04,0x20,0x7F,0xFE,0x7F,0xFE,0x04,0x20,0x3F,0xFC,0x01,0x08,0x19,0x98,0x09,0x90,0x01,0x80,0x7F,0xFE,0x07,0xE0,0x0D,0xB0,0x19,0x8C,0x61,0x86,0x01,0x80,0x00,0x00},
{0x0C,0x20,0x04,0x20,0x04,0x40,0x1F,0xF8,0x11,0x88,0x1F,0xF8,0x1F,0xF8,0x11,0x88,0x1F,0xF8,0x01,0x80,0x01,0x80,0x7F,0xFE,0x01,0x80,0x01,0x80,0x01,0x80,0x00,0x00},
{0x18,0x20,0x1F,0x7E,0x34,0x58,0x64,0x88,0x3F,0xF8,0x01,0x88,0x01,0x88,0x3F,0xF8,0x31,0x80,0x3F,0xFE,0x3F,0xFC,0x07,0x84,0x1D,0x8C,0x71,0x98,0x01,0x80,0x00,0x00},
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{0x00,0x20,0x7C,0x00,0x49,0xFE,0x48,0x98,0x5B,0xFE,0x50,0x00,0x59,0xFC,0x49,0x04,0x45,0xFC,0x45,0x04,0x58,0xF8,0x40,0x20,0x47,0xFE,0x40,0x20,0x00,0x20,0x00,0x00}
};

static const u8 g_zh_menu[]       = {0,1};
static const u8 g_zh_q3[]         = {2,3,4};
static const u8 g_zh_hold[]       = {5,6};
static const u8 g_zh_center[]     = {7,8,5,6};
static const u8 g_zh_capture[]    = {9,10,11,12};
static const u8 g_zh_captured[]   = {11,12,13,14};
static const u8 g_zh_free[]       = {15,16,17,18};
static const u8 g_zh_return[]     = {19,20,21,22};
static const u8 g_zh_lost[]       = {23,24,25,26};
static const u8 g_zh_estop[]      = {27,28};
static const u8 g_zh_fault[]      = {29,30};

static void I2C_Delay(void)
{
    volatile u8 i;
    for (i = 0; i < 24; i++) { __NOP(); }
}

static void SCL_High(void) { GPIOB->BSRR = OLED_SCL_PIN; }
static void SCL_Low(void)  { GPIOB->BRR  = OLED_SCL_PIN; }
static void SDA_High(void) { GPIOB->BSRR = OLED_SDA_PIN; }
static void SDA_Low(void)  { GPIOB->BRR  = OLED_SDA_PIN; }

static void I2C_Start(void)
{
    SDA_High(); SCL_High(); I2C_Delay();
    SDA_Low(); I2C_Delay(); SCL_Low();
}

static void I2C_Stop(void)
{
    SDA_Low(); SCL_High(); I2C_Delay();
    SDA_High(); I2C_Delay();
}

static u8 I2C_WriteByte(u8 value)
{
    u8 i, nack;
    for (i = 0; i < 8; i++) {
        if (value & 0x80u) SDA_High(); else SDA_Low();
        I2C_Delay(); SCL_High(); I2C_Delay(); SCL_Low();
        value <<= 1;
    }
    SDA_High(); I2C_Delay();
    SCL_High(); I2C_Delay();
    nack = (GPIOB->IDR & OLED_SDA_PIN) ? 1 : 0;
    SCL_Low();
    return nack ? 0 : 1;
}

static u8 OLED_WriteCommand(u8 cmd)
{
    u8 ok;
    I2C_Start();
    ok = I2C_WriteByte(OLED_ADDR_WRITE);
    if (ok) ok = I2C_WriteByte(0x00);
    if (ok) ok = I2C_WriteByte(cmd);
    I2C_Stop();
    return ok;
}

static void Glyph5x7(char ch, u8 out[5])
{
    static const u8 digits[10][5] = {
        {0x3E,0x51,0x49,0x45,0x3E},{0x00,0x42,0x7F,0x40,0x00},
        {0x42,0x61,0x51,0x49,0x46},{0x21,0x41,0x45,0x4B,0x31},
        {0x18,0x14,0x12,0x7F,0x10},{0x27,0x45,0x45,0x45,0x39},
        {0x3C,0x4A,0x49,0x49,0x30},{0x01,0x71,0x09,0x05,0x03},
        {0x36,0x49,0x49,0x49,0x36},{0x06,0x49,0x49,0x29,0x1E}
    };
    static const u8 letters[26][5] = {
        {0x7E,0x11,0x11,0x11,0x7E},{0x7F,0x49,0x49,0x49,0x36},
        {0x3E,0x41,0x41,0x41,0x22},{0x7F,0x41,0x41,0x22,0x1C},
        {0x7F,0x49,0x49,0x49,0x41},{0x7F,0x09,0x09,0x09,0x01},
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        {0x07,0x08,0x70,0x08,0x07},{0x61,0x51,0x49,0x45,0x43}
    };

    memset(out, 0, 5);
    if (ch >= 'a' && ch <= 'z') ch = (char)(ch - 'a' + 'A');
    if (ch >= '0' && ch <= '9') memcpy(out, digits[ch - '0'], 5);
    else if (ch >= 'A' && ch <= 'Z') memcpy(out, letters[ch - 'A'], 5);
    else if (ch == '-') { out[0]=out[1]=out[2]=out[3]=out[4]=0x08; }
    else if (ch == '+') { out[1]=0x08; out[2]=0x1C; out[3]=0x08; }
    else if (ch == '.') { out[2]=0x60; out[3]=0x60; }
    else if (ch == ':') { out[2]=0x36; out[3]=0x36; }
    else if (ch == '/') { out[0]=0x20; out[1]=0x10; out[2]=0x08; out[3]=0x04; out[4]=0x02; }
}

void OLED_Clear(void)
{
    memset(g_oled_buffer, 0, sizeof(g_oled_buffer));
}

void OLED_ShowLine(u8 row, const char *text)
{
    u8 x = 0;
    u8 glyph[5];
    u8 i;
    u16 base;

    if (row >= 8) return;
    base = (u16)row * 128u;
    memset(&g_oled_buffer[base], 0, 128);
    while (*text && x <= 122) {
        Glyph5x7(*text++, glyph);
        for (i = 0; i < 5; i++) g_oled_buffer[base + x + i] = glyph[i];
        x = (u8)(x + 6);
    }
}

static void OLED_DrawChineseGlyph(u8 x0, u8 y0, const u8 glyph[32])
{
    u8 x, y;
    u16 bits;
    u16 index;

    for (y = 0; y < 16; y++) {
        bits = ((u16)glyph[(u16)y * 2u] << 8) |
               glyph[(u16)y * 2u + 1u];
        for (x = 0; x < 16; x++) {
            if (bits & ((u16)0x8000u >> x)) {
                index = (u16)((y0 + y) >> 3) * 128u + x0 + x;
                g_oled_buffer[index] |= (u8)(1u << ((y0 + y) & 7u));
            }
        }
    }
}

void OLED_ShowChineseLine(u8 row16, OLED_ZhText text)
{
    const u8 *phrase = g_zh_menu;
    u8 length = sizeof(g_zh_menu);
    u8 i;
    u16 base;

    if (row16 >= 4) return;
    switch (text) {
    case OLED_ZH_Q3:          phrase = g_zh_q3;       length = sizeof(g_zh_q3); break;
    case OLED_ZH_HOLD:        phrase = g_zh_hold;     length = sizeof(g_zh_hold); break;
    case OLED_ZH_CENTER_HOLD: phrase = g_zh_center;   length = sizeof(g_zh_center); break;
    case OLED_ZH_CAPTURE:     phrase = g_zh_capture;  length = sizeof(g_zh_capture); break;
    case OLED_ZH_CAPTURED:    phrase = g_zh_captured; length = sizeof(g_zh_captured); break;
    case OLED_ZH_FREE_HOLD:   phrase = g_zh_free;     length = sizeof(g_zh_free); break;
    case OLED_ZH_RETURN_ZERO: phrase = g_zh_return;   length = sizeof(g_zh_return); break;
    case OLED_ZH_BALL_LOST:   phrase = g_zh_lost;     length = sizeof(g_zh_lost); break;
    case OLED_ZH_ESTOP:       phrase = g_zh_estop;    length = sizeof(g_zh_estop); break;
    case OLED_ZH_FAULT:       phrase = g_zh_fault;    length = sizeof(g_zh_fault); break;
    case OLED_ZH_MENU:
    default:                  phrase = g_zh_menu;     length = sizeof(g_zh_menu); break;
    }

    base = (u16)row16 * 256u;
    memset(&g_oled_buffer[base], 0, 256);
    if (length > 8u) length = 8u;
    for (i = 0; i < length; i++) {
        OLED_DrawChineseGlyph((u8)(i * 16u), (u8)(row16 * 16u),
                              g_zh_glyphs[phrase[i]]);
    }
}

u8 OLED_Refresh(void)
{
    u8 page, x, ok;
    for (page = 0; page < 8; page++) {
        if (!OLED_WriteCommand((u8)(0xB0u + page)) ||
            !OLED_WriteCommand(0x00) || !OLED_WriteCommand(0x10)) return 0;
        I2C_Start();
        ok = I2C_WriteByte(OLED_ADDR_WRITE);
        if (ok) ok = I2C_WriteByte(0x40);
        for (x = 0; ok && x < 128; x++) {
            ok = I2C_WriteByte(g_oled_buffer[(u16)page * 128u + x]);
        }
        I2C_Stop();
        if (!ok) return 0;
    }
    return 1;
}

u8 OLED_Init(void)
{
    GPIO_InitTypeDef gpio;
    static const u8 init_cmds[] = {
        0xAE,0x20,0x02,0xB0,0xC8,0x00,0x10,0x40,0x81,0x7F,
        0xA1,0xA6,0xA8,0x3F,0xA4,0xD3,0x00,0xD5,0x80,0xD9,
        0xF1,0xDA,0x12,0xDB,0x40,0x8D,0x14,0xAF
    };
    u8 i;

    RCC_APB2PeriphClockCmd(RCC_APB2Periph_GPIOB, ENABLE);
    gpio.GPIO_Pin = OLED_SCL_PIN | OLED_SDA_PIN;
    gpio.GPIO_Mode = GPIO_Mode_Out_OD;
    gpio.GPIO_Speed = GPIO_Speed_2MHz;
    GPIO_Init(GPIOB, &gpio);
    SCL_High(); SDA_High();

    for (i = 0; i < sizeof(init_cmds); i++) {
        if (!OLED_WriteCommand(init_cmds[i])) return 0;
    }
    OLED_Clear();
    OLED_ShowLine(0, "GIMBAL BOOT");
    return OLED_Refresh();
}
